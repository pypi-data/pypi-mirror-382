AUTOSAR XML
package /EcuConfig
  ecu instance MainECU: sw-version=3.2.1-RC2
  can cluster CAN_Network
    can physical channel CAN_Channel_1
    can physical channel CAN_Channel_2
